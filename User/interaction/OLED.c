#include  "OLED.h" 


#define OLED_SCL_H  GPIO_SetBits (GPIOG	, GPIO_Pin_14)
#define OLED_SDA_H  GPIO_SetBits (GPIOG	, GPIO_Pin_13)
#define OLED_RST_H  GPIO_SetBits (GPIOG	, GPIO_Pin_12)
#define OLED_DC_H   GPIO_SetBits (GPIOG	, GPIO_Pin_11)
#define OLED_CS_H   GPIO_SetBits (GPIOG	, GPIO_Pin_10)

#define OLED_SCL_L  GPIO_ResetBits (GPIOG	, GPIO_Pin_14)
#define OLED_SDA_L  GPIO_ResetBits (GPIOG	, GPIO_Pin_13)
#define OLED_RST_L  GPIO_ResetBits (GPIOG	, GPIO_Pin_12)
#define OLED_DC_L   GPIO_ResetBits (GPIOG	, GPIO_Pin_11)
#define OLED_CS_L   GPIO_ResetBits (GPIOG	, GPIO_Pin_10)

/******************************************************/
/*******************  ASCII码字库    ******************/
/******************************************************/

const unsigned char Font_8x16[1520]=
{
    0x00,0x00,0x00,0x00,0x00,0x00,0x00,0x00,0x00,0x00,0x00,0x00,0x00,0x00,0x00,0x00,//  0
    0x00,0x00,0x00,0xF8,0x00,0x00,0x00,0x00,0x00,0x00,0x00,0x33,0x30,0x00,0x00,0x00,//! 1
    0x00,0x10,0x0C,0x06,0x10,0x0C,0x06,0x00,0x00,0x00,0x00,0x00,0x00,0x00,0x00,0x00,//" 2
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    0x00,0x06,0x01,0x01,0x02,0x02,0x04,0x04,0x00,0x00,0x00,0x00,0x00,0x00,0x00,0x00,//~ 94
};

/******************************************************/
/********************  OLED函数    ********************/
/******************************************************/


/*--------------------*OLED写数据*--------------------*/

void OLED_Write_Data(unsigned char Data)
{
    unsigned char Temp_i=8;
    OLED_DC_H;
    OLED_SCL_L;
    while(Temp_i--)
    {
        if(Data&0x80){OLED_SDA_H;}
        else{OLED_SDA_L;}
        OLED_SCL_H; 
        __nop();
        OLED_SCL_L;;    
        Data<<=1;    
    }
}

/*--------------------*OLED写命令*--------------------*/

void OLED_Write_Command(unsigned char Cmd)
{
    unsigned char Temp_i=8;
    
    OLED_DC_L;;
    OLED_SCL_L;;
    while(Temp_i--)
    {
        if(Cmd&0x80){OLED_SDA_H;}
        else{ OLED_SDA_L;;}
        OLED_SCL_H;;
        __nop();
        OLED_SCL_L;;    
        Cmd<<=1;;   
    } 	
}

/*-------------------*整型转字符串*-------------------*/

void OLED_Set_Pos(unsigned char x,unsigned char y)
{ 
    OLED_Write_Command(0xb0+y);
    OLED_Write_Command(((x&0xf0)>>4)|0x10);
    OLED_Write_Command(x&0x0f); 
} 

/*-------------------*整型转字符串*-------------------*/

void OLED_Fill(unsigned char Bmp_data)
{
    unsigned char y,x;
    
    for(y=0;y<8;y++)
    {
        OLED_Write_Command(0xb0+y);
        OLED_Write_Command(0x01);
        OLED_Write_Command(0x10);
        for(x=0;x<X_WIDTH;x++)
            OLED_Write_Data(Bmp_data);
    }
}

/*---------------------*OLED清屏*---------------------*/

void OLED_Clear(void)
// 全部写上0
{
#if _USE_LCD
    LCD_TFT_Clear(BGCOLOR);
#elif _USE_IPS
	ips_clear(IPS_BGCOLOR);
#else
    OLED_Fill(0x00);
#endif
}

/*--------------------*OLED初始化*--------------------*/

void OLED_IO_Init(void)  
{
		GPIO_InitTypeDef GPIO_InitStructure;
		RCC_AHB1PeriphClockCmd ( RCC_AHB1Periph_GPIOG, ENABLE); 

		/*设置引脚模式为输出模式*/
		GPIO_InitStructure.GPIO_Mode = GPIO_Mode_OUT;   
    GPIO_InitStructure.GPIO_OType = GPIO_OType_PP;
    GPIO_InitStructure.GPIO_PuPd = GPIO_PuPd_DOWN;
		GPIO_InitStructure.GPIO_Speed = GPIO_Speed_100MHz; 
	  
		GPIO_InitStructure.GPIO_Pin = GPIO_Pin_11 | GPIO_Pin_12 | GPIO_Pin_13 | GPIO_Pin_14;	
		GPIO_Init(GPIOG, &GPIO_InitStructure);	
}

void OLED_Init(void)        
{
    unsigned int Temp_Count;
    OLED_IO_Init();
    OLED_SCL_H;
    OLED_RST_L;
    for(Temp_Count=0;Temp_Count<50000;Temp_Count++);
    
    OLED_RST_H;
    //从上电到下面开始初始化要有足够的时间，即等待RC复位完毕
    OLED_Write_Command(0xAE|0x00);			                // Display Off (0x00/0x01)
    OLED_Write_Command(0xD5);OLED_Write_Command(0x80);	// Set Clock as 100 Frames/Sec
    OLED_Write_Command(0xA8);OLED_Write_Command(0x3F);	// 1/64 Duty (0x0F~0x3F)
    OLED_Write_Command(0xD3);OLED_Write_Command(0x00);	// Shift Mapping RAM Counter (0x00~0x3F)
    OLED_Write_Command(0x40|0x00);			                // Set Mapping RAM Display Start Line (0x00~0x3F)
    OLED_Write_Command(0x8D);OLED_Write_Command(0x10|0x04);	    // Enable Embedded DC/DC Converter (0x00/0x04)
    OLED_Write_Command(0x20);OLED_Write_Command(0x02);		      // Set Page Addressing Mode (0x00/0x01/0x02)
    OLED_Write_Command(0xA0|0x01);                      // Set SEG/Column Mapping     0x00左右反置 0x01正常
    OLED_Write_Command(0xC0|0x08);			                // Set COM/Row Scan Direction 0x00上下反置 0x08正常
    OLED_Write_Command(0xDA);OLED_Write_Command(0x02|0x10);	    // Set Sequential Configuration (0x00/0x10)
    OLED_Write_Command(0x81);OLED_Write_Command(0xCF);	  // Set SEG Output Current
    OLED_Write_Command(0xD9);OLED_Write_Command(0xF1);	        // Set Pre-Charge as 15 Clocks & Discharge as 1 Clock
    OLED_Write_Command(0xDB);OLED_Write_Command(0x40);			    // Set VCOM Deselect Level
    OLED_Write_Command(0xA4|0x00);		                  // Disable Entire Display On (0x00/0x01)
    OLED_Write_Command(0xA6|0x00);		                  // Disable Inverse Display On (0x00/0x01)  
    OLED_Write_Command(0xAE|0x01);		                  // Display On (0x00/0x01)
    OLED_Clear();                                       // 初始清屏
    OLED_Set_Pos(0,0); 
} 

/*-------------------*整型转字符串*-------------------*/

signed int Int_To_String(signed long Int_Num,signed char String[])
// 返回字符串长度
{
    signed int Num_Length=0;
    signed char Negative_Flag=0;
    signed char *Point_p=String;                //做换向时用的指针
    signed char *Point_s=String;
    if(Int_Num<0)
    {
        Negative_Flag=1;
        Int_Num=0-Int_Num;
    }
    if(Int_Num==0)
        String[Num_Length++]='0';
    while(Int_Num>0)
    {
        String[Num_Length++]=Int_Num%10+'0';
        Int_Num=Int_Num/10;
    }
    if(Negative_Flag)
        String[Num_Length++]='-';
    String[Num_Length]='\0';
    Point_p=String+Num_Length-1;                //将P指针指向字符串结束标志之前
    
    for(;Point_p-Point_s>0;Point_p--,Point_s++) //将字符串中存储的数调头   
    {   
        *Point_s^=*Point_p;   
        *Point_p^=*Point_s;   
        *Point_s^=*Point_p;   
    }   
    return(Num_Length);
}

/*------------------*浮点型转字符串*------------------*/

signed int Float_To_String(float Float_Num,signed char String[])
// Dot_Size为小数点后边保留位数
// 返回字符串长度
{
    signed int Num_Length=0;
    signed int Temp_i=0;
    signed char *Point_p=String;                //做换向时用的指针
    signed char *Point_s=String;
    signed char Negative_Flag=0;
    signed long Predot_Num;
    signed long Afterdot_Num;
    float Afterdot_Float;
    
    if(Float_Num<0)
    {
        Negative_Flag=1;
        Float_Num=0-Float_Num;
    }
    
    Predot_Num=(signed long)Float_Num;          //将小数点之前的数变为整数
    Afterdot_Float=Float_Num-Predot_Num;        //单独取出小数点之后的数
    for(Temp_i=Dot_Size;Temp_i>0;Temp_i--)
    {
        Afterdot_Float=Afterdot_Float*10;
    }
    Afterdot_Num=(signed long)Afterdot_Float;
    
    Temp_i=Dot_Size;
    
    while(Afterdot_Num>0|Temp_i>0)
    {
        Temp_i--;
        String[Num_Length++]=Afterdot_Num%10+'0';
        Afterdot_Num=Afterdot_Num/10;
    }
    String[Num_Length++]='.';
    
    if(Predot_Num==0)                           //处理小数点前为0的情况
        String[Num_Length++]='0';
    
    while(Predot_Num>0)
    {
        String[Num_Length++]=Predot_Num%10+'0';
        Predot_Num=Predot_Num/10;
    }
    
    if(Negative_Flag==1)
        String[Num_Length++]='-';
    String[Num_Length]='\0';                    //加上字符串结束标志
    
    Point_p=String+Num_Length-1;                //将P指针指向字符串结束标志之前
    
    for(;Point_p-Point_s>0;Point_p--,Point_s++) //将字符串中存储的数调头   
    {   
        *Point_s^=*Point_p;   
        *Point_p^=*Point_s;   
        *Point_s^=*Point_p;   
    }   
    
    return(Num_Length);
}


/******************************************************/
/********************  生成接口    ********************/
/******************************************************/

/*-----------------*OLED写一个字符串*-----------------*/      

void OLED_Write_String(unsigned char x,unsigned char y,signed char String[])
{
    unsigned char Temp_Char=0,Temp_i=0,Temp_j=0;
    
    while(String[Temp_j]!='\0')
    {    
        Temp_Char=String[Temp_j]-32;
        if(y>128){y=0;x++;}
        OLED_Set_Pos(y,x);    
  	for(Temp_i=0;Temp_i<8;Temp_i++)     
            OLED_Write_Data(Font_8x16[Temp_Char*16+Temp_i]);
  	OLED_Set_Pos(y,x+1);    
  	for(Temp_i=0;Temp_i<8;Temp_i++)     
            OLED_Write_Data(Font_8x16[Temp_Char*16+Temp_i+8]);  
  	y+=8;
  	Temp_j++;
    }
}

/*-----------------*OLED写一个字符*-------------------*/      

void OLED_Write_Char(unsigned char x,unsigned char y,signed char Asc) 
{
    signed char Temp_String[2];
    y=y*8;        
    Temp_String[0]=Asc;	
    Temp_String[1]='\0';			                  //字母占一个字节
    OLED_Write_String(x,y,Temp_String);	        //显示字母
}

///*-----------------*OLED写一个字符*-------------------*/      

//void OLED_Write_Draw(unsigned char x,unsigned char y,signed char Asc) 
//{
//    unsigned char Temp_i;
//    unsigned char Temp_Char;
//    y=y*8;        
//    
//    Temp_Char=Asc;
//    
//    OLED_Set_Pos(y,x);    
//    for(Temp_i=0;Temp_i<8;Temp_i++)     
//        OLED_Write_Data(Draw[Temp_Char*16+Temp_i]);
//    OLED_Set_Pos(y,x+1);    
//    for(Temp_i=0;Temp_i<8;Temp_i++)     
//        OLED_Write_Data(Draw[Temp_Char*16+Temp_i+8]);  
//}      


/*----------------*OLED写一个整型数据*----------------*/      

void OLED_Write_Int(unsigned char x,unsigned char y,signed int Number)
{
    signed char Temp_Buf[17];
    (void)Int_To_String(Number,Temp_Buf);
#if _USE_LCD
    LCD_DispString(y,x,Temp_Buf);
#elif _USE_IPS
	IPS_DispString(y, x, Temp_Buf);
#else
    OLED_Write_String(x,y,Temp_Buf);   
#endif
}

/*---------------*OLED写一个浮点型数据*---------------*/

void OLED_Write_Float(unsigned char x,unsigned char y,float Number)
{
    signed char Temp_Buf[17];
    (void)Float_To_String(Number,Temp_Buf);
#if _USE_LCD
    LCD_DispString(y,x,Temp_Buf);
#elif _USE_IPS
	IPS_DispString(y, x, Temp_Buf);
#else
    OLED_Write_String(x,y,Temp_Buf);   
#endif  
}
